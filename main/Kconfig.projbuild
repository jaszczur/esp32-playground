## main/Kconfig.projbuild
```kconfig
menu "Jaszczur Playground Configuration"

    config ESP_WIFI_SSID
        string "WiFi SSID"
        default "myssid"
        help
            SSID (network name) for the example to connect to.

    config ESP_WIFI_PASSWORD
        string "WiFi Password"
        default "mypassword"
        help
            WiFi password (WPA or WPA2) for the example to use.

    config ESP_MAXIMUM_RETRY
        int "Maximum retry"
        default 5
        help
            Set the Maximum retry to avoid station reconnecting to the AP unlimited when the AP is really inexistent.

    config ESP_MQTT_URL
        string "MQTT broker url"
        default "mqtt://192.168.1.2"
        help
            The MQTT broker URL to which send the readings
endmenu
```
